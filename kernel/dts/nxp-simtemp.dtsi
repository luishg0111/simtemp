/* NXP Simulated Temperature Sensor node */

simtemp@0 {
    compatible = "nxp,simtemp";
    sampling-ms = <100>;       /* período de muestreo en milisegundos */
    threshold-mC = <45000>;    /* umbral en milicelsius */
    status = "okay";
};